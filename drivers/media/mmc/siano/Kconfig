## drivers/media/mtv/Kconfig
```kconfig
#
# MTV config states
#

############################################
# Define following features for MOBILETV(MTV) in defconfig file
############################################
# ex..
# MTV function - CONFIG_MTV
# AP Vendor - CONFIG_MTV_QUALCOMM
# Chip Vendor - CONFIG_MTV_MTV222
# Interface - CONFIG_MTV_SPI 
############################################

config MTV
	bool "ISDB-T"
	default n
	help
	  This allows MTV.
	  This module is designed for SPI or TSIF.
	  Select chipset and interface

choice
	depends on MTV
	prompt "AP vendor"
	default MTV_QUALCOMM
	config MTV_QUALCOMM
		bool "Qualcomm"
	config MTV_SLSI
		bool "S.LSI"
	config MTV_MARVELL
		bool "Marvell"
	config MTV_BROADCOM
		bool "Broadcom"
	config MTV_SPREADTRUM
		bool "Spreadtrum"
endchoice

choice
	depends on MTV
	prompt "chip"
	default MTV_FC8300
	config MTV_FC8150
		bool "FCI8150"
	config MTV_FC8300
		bool "FCI8300"
	config MTV_MTV222
		bool "MTV222"
	config MTV_MTV23x
		bool "MTV23x"
	config MTV_SMS3230
		bool "SMS3230"
endchoice

config MTV_SPI
	depends on MTV
	default n
	bool "SPI"

config MTV_EBI
	depends on MTV
	default n
	bool "EBI"
	
config MTV_TSIF
	depends on MTV
	default n
	bool "TSIF"

config MTV_I2C
	depends on MTV
	default n
	bool "I2C"

config MTV_SIMUL
	depends on MTV
	default n
	bool "Simulation"

config MTV_DEBUG
	depends on MTV
	default n
	bool "isdbt debugfs"

config MTV_ANT_DET
	depends on MTV
	default n
	bool "isdbt antenna detector"
	
# Hardware interfaces support

config SMS_USB_DRV
	bool "USB interface support"
	depends on USB && DVB_CORE
	select MEDIA_COMMON_OPTIONS
	default n if USB
	---help---
	  Choose if you would like to have Siano's support for USB interface

config SMS_SDIO_DRV
	bool "SDIO interface support"
	depends on DVB_CORE && HAS_DMA
	depends on MMC
	select MEDIA_COMMON_OPTIONS
	---help---
	  Choose if you would like to have Siano's support for SDIO interface

source "drivers/media/mtv/sms3230/Kconfig"
```
